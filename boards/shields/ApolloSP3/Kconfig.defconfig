## boards/shields/ApolloSP3/Kconfig.defconfig
```kconfig
if SHIELD_APOLLOSP3_RIGHT #ここを変えてセントラル側に問題のコードを移行

# Name must be less than 16 characters long!
config ZMK_KEYBOARD_NAME
    default "ApolloSP3"

config ZMK_SPLIT_ROLE_CENTRAL
    default y

endif

if SHIELD_APOLLOSP3_LEFT || SHIELD_APOLLOSP3_RIGHT

config ZMK_SPLIT
    default y

endif

# Input Device(pmw3610)のためのコンフィグ
if SHIELD_APOLLOSP3_RIGHT

# Other settings

config ZMK_POINTING
    default y

# Assuming pointing device uses SPI
config SPI
    default y

endif
```

## boards/shields/ApolloSP3/Kconfig.shield
```kconfig
#No whitespace after the comma or in your part name!
config SHIELD_APOLLOSP3_LEFT
	def_bool $(shields_list_contains,ApolloSP3_left)

config SHIELD_APOLLOSP3_RIGHT
	def_bool $(shields_list_contains,ApolloSP3_right)
```

## boards/shields/apollosp3/Kconfig.defconfig
```kconfig
# defconfigには先ほど定義した左右のシールドに対する設定を書きます。
# ここでは、左手のデバイスをPCと接続するBLEデバイスとしています。

if SHIELD_APOLLOSP3_LEFT

# 左手（Central）側のデバイス名
config ZMK_KEYBOARD_NAME
    default "ap_l"

# 左手側をBluetooth接続の親機（Central）として設定
config ZMK_SPLIT_BLE_ROLE_CENTRAL
    default y

endif

if SHIELD_APOLLOSP3_RIGHT

# 右手（Peripheral）側のデバイス名
# 書き込み時に区別しやすいよう名前を変えることも可能ですが、通常は統一します
config ZMK_KEYBOARD_NAME
    default "ap_r"

endif

if SHIELD_APOLLOSP3_LEFT || SHIELD_APOLLOSP3_RIGHT

# 分離型キーボードであることを定義
config ZMK_SPLIT
    default y

endif
```

## config/boards/shields/apollosp3/Kconfig.defconfig
```kconfig
if SHIELD_APOLLOSP3_LEFT

config ZMK_KEYBOARD_NAME
    default "ApolloSP3"

# 「BLE_」を抜いたこの形が正解です
config ZMK_SPLIT_ROLE_CENTRAL
    default y

endif

if SHIELD_APOLLOSP3_LEFT || SHIELD_APOLLOSP3_RIGHT
config ZMK_SPLIT
    default y
endif
```

## config/config/boards/shields/apollosp3/Kconfig.shield
```kconfig
// 左右を定義するために、shieldに定義を書きます。

config SHIELD_APOLLOSP3_LEFT
    def_bool $(shields_list_contains,apollosp3_left)

config SHIELD_APOLLOSP3_RIGHT
    def_bool $(shields_list_contains,apollosp3_right)
```
