#include <dt-bindings/zmk/matrix_transform.h>

/ {
    chosen {
        zmk,kscan = &kscan0;
		zmk,matrix_transform = &default_transform;
    };

    default_transform: keymap_transform_0 {
		compatible = "zmk,matrix-transform";
		columns = <4>;
		rows = <1>;
		map = <
		       RC(0,0) 	RC(0,1)  RC(0,2)  RC(0,3)
		>;
	};


    kscan0: kscan {
        compatible = "zmk,kscan-gpio-direct";
        label = "KSCAN";
        input-gpios
            = <&gpio0 9  (GPIO_ACTIVE_LOW | GPIO_PULL_UP)>, // D10
			  <&gpio0 10  (GPIO_ACTIVE_LOW | GPIO_PULL_UP)>, // D16
			  <&gpio1 11  (GPIO_ACTIVE_LOW | GPIO_PULL_UP)>, // D14
			  <&gpio1 13  (GPIO_ACTIVE_LOW | GPIO_PULL_UP)>; // D15
    };
};
