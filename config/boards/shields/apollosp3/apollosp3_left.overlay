#include "apollosp3.dtsi"

&kscan0 {
    col-gpios
        = <&gpio1 15 GPIO_ACTIVE_LOW>
        , <&gpio0 2  GPIO_ACTIVE_LOW>
        , <&gpio1 11 GPIO_ACTIVE_LOW>
        , <&gpio0 11 GPIO_ACTIVE_LOW>
        , <&gpio0 24 GPIO_ACTIVE_LOW>;
};
